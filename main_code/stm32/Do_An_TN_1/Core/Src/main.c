/* USER CODE BEGIN Header */
/**
  ******************************************************************************
  * @file           : main.c
  * @brief          : Main program body
  ******************************************************************************
  * @attention
  *
  * Copyright (c) 2024 STMicroelectronics.
  * All rights reserved.
  *
  * This software is licensed under terms that can be found in the LICENSE file
  * in the root directory of this software component.
  * If no LICENSE file comes with this software, it is provided AS-IS.
  *
  ******************************************************************************
  */
/* USER CODE END Header */
/* Includes ------------------------------------------------------------------*/
#include "main.h"

/* Private includes ----------------------------------------------------------*/
/* USER CODE BEGIN Includes */
#include "PID_Control.h"  // Thư viện PID Controller
#include "Fuzzy_01.h"  // Thư viện Fuzzy Controller
#include "PID_XY.h"  // Thư viện PID xy theta
#include "math.h"
#include "string.h"
#include <stdio.h>
#include "ssd1306.h"
#include "ssd1306_tests.h"
#include "ssd1306_fonts.h"
/* USER CODE END Includes */

/* Private typedef -----------------------------------------------------------*/
/* USER CODE BEGIN PTD */

/* USER CODE END PTD */

/* Private define ------------------------------------------------------------*/
/* USER CODE BEGIN PD */
#define RxSIZE 6
#define Max_Array_XY 3000
/* USER CODE END PD */

/* Private macro -------------------------------------------------------------*/
/* USER CODE BEGIN PM */

/* USER CODE END PM */

/* Private variables ---------------------------------------------------------*/
I2C_HandleTypeDef hi2c1;
I2C_HandleTypeDef hi2c2;

SPI_HandleTypeDef hspi1;

TIM_HandleTypeDef htim1;
TIM_HandleTypeDef htim2;
TIM_HandleTypeDef htim3;
TIM_HandleTypeDef htim4;
TIM_HandleTypeDef htim5;
TIM_HandleTypeDef htim6;
TIM_HandleTypeDef htim8;
TIM_HandleTypeDef htim9;
TIM_HandleTypeDef htim10;
TIM_HandleTypeDef htim11;

UART_HandleTypeDef huart1;
UART_HandleTypeDef huart2;

/* USER CODE BEGIN PV */
/************************************************* Fuzzy Variable  **********************************************/
 // Tạo Input theo lần lược từ thấp đến lớn với mỗi mảng có 3 giá trị Input[x][3]
 float IN_01[5][3] = {{-1000000, -0.8, -0.5}, {-0.8, -0.5, 0}, {-0.2, 0, 0.2}, {0, 0.5, 0.8}, {0.5, 0.8, 1000000}};
 float IN_02[5][3] = {{-1000000, -0.6, -0.2}, {-0.3, -0.2, 0}, {-0.2, 0, 0.2}, {0, 0.2, 0.4}, {0.2, 0.6, 1000000}};
 //{{-1000000, -0.6, -0.4}, {-0.6, -0.4, 0}, {-0.1, 0, 0.1}, {0, 0.4, 0.6}, {0.5, 0.8, 1000000}};x2
 //{{-1000000, -0.8, -0.5}, {-0.8, -0.5, 0}, {-0.2, 0, 0.2}, {0, 0.5, 0.8}, {0.5, 0.8, 1000000}};x2
// //1.0
// float IN_01[5][3] = {{-1000000, -0.8, -0.5}, {-0.8, -0.5, 0}, {-0.2, 0, 0.2}, {0, 0.5, 0.8}, {0.5, 0.8, 1000000}};
// float IN_02[5][3] = {{-1000000, -0.6, -0.2}, {-0.3, -0.2, 0}, {-0.2, 0, 0.2}, {0, 0.2, 0.4}, {0.2, 0.6, 1000000}};
 // Tạo Output
 float OUT_01[5] = {-1, -0.3, 0, 0.3, 1};
 float o1;
 // Tạo mảng cho ID và giá trị của ID so sánh
 int8_t ID1[5], ID2[5];
 float Value_ID_1[5], Value_ID_2[5];
 // Tạo mảng lưu Output
 float Temp_01[25][2];
 float Temp_02[2];
 float Output_PWM_Fuzzy;
 float Output_PWM_Fuzzy_Temp;
 float error_integration_fuzzy; // Tích phân của sai số cho tính toán fuzzy
 float error_integration_fuzzy_P; // Giá trị trước
 float e1, e2;

 // Oled
 float a_float = 0.0;
 uint16_t ax1, ay1;
 char str10[10];
 uint16_t x_1, y_1;
 uint16_t Radius;

 // I2C
 uint8_t RxData[RxSIZE];
 uint32_t a_00 ;
 float dec;
 uint8_t exponent;
 uint64_t mu;
 uint8_t bit_end = 0;
 float Mang_quy_dao_X[Max_Array_XY];  // Mang chua cac quy dao x
 float Mang_quy_dao_Y[Max_Array_XY];  // Mang chua cac quy dao y
 float Mang_quy_dao_X_m[Max_Array_XY];  // Mang chua cac quy dao x
 float Mang_quy_dao_Y_m[Max_Array_XY];  // Mang chua cac quy dao y
 uint16_t Num_X, Num_Y; // Bien dem cua X vs Y
 float real_num;
 uint32_t Num_Array = 0 ;
 uint8_t First_4_bits, Second_4_bits;
 uint8_t Start_bit_1,  Start_bit_2;


 // Duy Nhat
 /******************************************************************************/
 char str1[50];
 char buffer1[50]; // �?ịnh nghĩa một mảng char đủ lớn để chứa kết quả
 int length1;

 char str2[50];
 char buffer2[50];
 int length2;

 char str3[50];
 char buffer3[50];
 int length3;

 char str4[50];
 char buffer4[50];
 int length4;

 char str5[50];
 char buffer5[50];
 int length5;

 char str6[50];
 char buffer6[50];
 int length6;

 float t = 0.0;
 double a1,a2,a3,a4,a5,a6 ;
 float b1,b2,b3,b4,b5,b6 ;
 double a = 0.0;
 int count;

 float c1, c2, c3, c4;
 uint8_t Data_001[]  = "s";
 uint8_t Size_Data ;

 /******************************************************************************/
 float EX, EY, E_Velocity, Error_Distance;

 /************************************************* Mobile Robot Variable  **********************************************/

 // Thông số toán h�?c
 float PI = 3.1415926535897932;
 float Time_Interrupt_global = 0.05; // Th�?i gian ngắt toàn cục

 // Thông số quỹ đạo
	float Delta_S = 0.00001; // Khoảng cách giữa hai điểm x và x+1
	float a_0 = 0.5;
	float b = 0.0;
	float Mang_Robot_1[2][2] = {{0,0},{0,0}};
	uint32_t Vi_tri_1 = 0;
	float ek_mm, ek_degree;
	float Stepper_L;
	float Time_10 = 0;
	float Khoang_cach_mm_1;

	// Stepper
	int32_t Counter_AC;
	int32_t Diem_dung = 0;
	int8_t DIR;



	float AY[] = {
	        -5.01000, -4.51000, -4.01000, -3.51000, -3.01000, -2.51000, -2.01000, -1.51000, -1.01000, -0.51000,
	        -0.01000, 0.49000, 0.99000, 1.49000, 1.99000, 2.49000, 2.99000, 3.49000, 3.99000, 4.49000,
	        4.99000, 5.49000, 5.99000, 6.49000, 6.99000, 7.49000, -4.01000, -3.51000, -3.01000, -2.51000,
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	        -0.01000, 0.49000
	    };
	float AX[] = {
	        -0.128985332, 0.766782498, 1.462317328, 1.974269158, 2.319287988, 2.514023818, 2.575126648, 2.519246478,
	        2.363033308, 2.123137138, 1.816207968, 1.458895798, 1.067850628, 0.659722458, 0.251161288, -0.141182882,
	        -0.500660052, -0.810620222, -1.054413392, -1.215389562, -1.276898732, -1.222290902, -1.034916072,
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	        -1.054413392, -1.215389562, -1.276898732, -1.222290902, 1.816207968, 1.458895798
	    };
//	float AY[] = {-5.01, -4.51, -4.01, -3.51, -3.01, -2.51, -2.01, -1.51, -1.01, -0.51, -0.01, 0.49, 0.99,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 99.99, 100.49};
//	float AX[] ={-0.128985332, 0.766782498, 1.462317328, 1.974269158, 2.319287988, 2.514023818, 2.575126648, 2.519246478, 2.363033308, 2.123137138, 1.816207968, 1.458895798, 1.067850628,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 21127.17707, 21451.40816};

//	float AX[] = {115.96666666666667, 115.96666666666667, 115.96666666666667, 115.96666666666667, 115.96666666666667, 115.96666666666667, 115.96666666666667, 115.96666666666667, 115.96666666666667, 115.96666666666667, 115.96666666666667, 115.96666666666667, 115.96666666666667,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 110.83333333333333, 110.83333333333333};
//	float AY[] = {0.0, 0.23076923076923078, 0.46153846153846156, 0.6923076923076923, 0.9230769230769231, 1.153846153846154, 1.3846153846153846, 1.6153846153846154, 1.8461538461538463, 2.076923076923077, 2.307692307692308, 2.5384615384615388, 2.769230769230769,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 296.53846153846155, 296.7692307692308};
 // Thông số của hệ PID x y theta
 float Output_PID_K_0;
// Các thông số để tính toán động h�?c
 struct Kinematic
 {
	 float X_real, Y_real; // Vị trí robot hiện tại
	 float X_dot, Y_dot;  // Tốc độ theo phương X vs Y của robot hiện tại
	 float V_real, V_Set, V_Set_1;  // Vận tốc hiện tại vs đặt mong muốn của robot
	 float W_Real, W_Set; // Tốc độ quay của robot
	 float Theta_Real_Robot;  //Góc hiện tại của Robot so với trục hoành
	 float WR_Set, WR_Real, WL_Set, WL_Real;  // Tốc độ quay bánh trái và bánh phải
	 float VR_Set, VR_Real, VL_Set, VL_Real; // Tốc độ dài của bánh trái và bánh phải
	 float X_real_mm, Y_real_mm;
	 float X_Welding, Y_Welding, X_Welding_mm, Y_Welding_mm;

 }Kine;

// Thông số của xe
 struct Para_Mobile_Robot
 {
	 float R; // Bán kính bánh xe
	 float L;  // Khoảng cách 2 bánh xe
	 float Distance_X_tourch; // Khoảng cách cần hàn theo phương x của xe
	 float Distance_Y_tourch; // Khoảng cách cần hàn theo phương y của xe
 }Robot;

 struct Para_Motor Para_MR;
 struct Para_Motor Para_ML;
 struct Para_Motor* pt_Para_MR = &Para_MR;
 struct Para_Motor* pt_Para_ML = &Para_ML;
 struct Para_Mobile_Robot* pt_Robot = &Robot;
 struct Kinematic* pt_Kine = &Kine;

 struct PID_XY PID_Theta;
 struct PID_XY PID_Posision;
 struct Possision_Input Pos_1;
 struct PID_XY* pt_PID_theta = &PID_Theta;
 struct PID_XY* pt_PID_posision = &PID_Posision;
 struct Possision_Input* pt_pos_1 = &Pos_1;

 /*****************************************************/
/* USER CODE END PV */

/* Private function prototypes -----------------------------------------------*/
void SystemClock_Config(void);
static void MX_GPIO_Init(void);
static void MX_TIM2_Init(void);
static void MX_TIM3_Init(void);
static void MX_TIM4_Init(void);
static void MX_I2C1_Init(void);
static void MX_I2C2_Init(void);
static void MX_SPI1_Init(void);
static void MX_TIM1_Init(void);
static void MX_TIM5_Init(void);
static void MX_USART1_UART_Init(void);
static void MX_USART2_UART_Init(void);
static void MX_TIM8_Init(void);
static void MX_TIM9_Init(void);
static void MX_TIM6_Init(void);
static void MX_TIM10_Init(void);
static void MX_TIM11_Init(void);
/* USER CODE BEGIN PFP */

/* USER CODE END PFP */

/* Private user code ---------------------------------------------------------*/
/* USER CODE BEGIN 0 */

/* USER CODE END 0 */

/**
  * @brief  The application entry point.
  * @retval int
  */
int main(void)
{
  /* USER CODE BEGIN 1 */

  /* USER CODE END 1 */

  /* MCU Configuration--------------------------------------------------------*/

  /* Reset of all peripherals, Initializes the Flash interface and the Systick. */
  HAL_Init();

  /* USER CODE BEGIN Init */
  pt_Para_MR->Kb = 900;
  pt_Para_MR->Kp = 0.0671641791;
  pt_Para_MR->Ki = 300;
  pt_Para_MR->Kd = 0;

  pt_Para_MR->Ui_1 = 0;
  pt_Para_MR->Ud_1 = 0;

  pt_Para_MR->HIGH = 999;
  pt_Para_MR->LOW = 0;

  pt_Para_ML->Kb = 900;
  pt_Para_ML->Kp = 0.0671641791;
  pt_Para_ML->Ki = 300;
  pt_Para_ML->Kd = 0;

  pt_Para_ML->Ui_1 = 0;
  pt_Para_ML->Ud_1 = 0;

  pt_Para_ML->HIGH = 999;
  pt_Para_ML->LOW = 0;

//  pt_Para_MR->SP_Rad_s = 1.5;
//  pt_Para_ML->SP_Rad_s = 1.5;
/* USER CODE END SysInit */
  /* USER CODE END Init */

  /* Configure the system clock */
  SystemClock_Config();

  /* USER CODE BEGIN SysInit */

  /* USER CODE END SysInit */

  /* Initialize all configured peripherals */
  MX_GPIO_Init();
  MX_TIM2_Init();
  MX_TIM3_Init();
  MX_TIM4_Init();
  MX_I2C1_Init();
  MX_I2C2_Init();
  MX_SPI1_Init();
  MX_TIM1_Init();
  MX_TIM5_Init();
  MX_USART1_UART_Init();
  MX_USART2_UART_Init();
  MX_TIM8_Init();
  MX_TIM9_Init();
  MX_TIM6_Init();
  MX_TIM10_Init();
  MX_TIM11_Init();
  /* USER CODE BEGIN 2 */
  void HAL_TIM_PeriodElapsedCallback(TIM_HandleTypeDef *htim);
  void Initial_Mobile_Robot(struct Para_Mobile_Robot* Ro);
  void Initial_PID_XY(struct PID_XY* Pos, struct PID_XY* Theta);
  void Inverse_Right_Motor(int DIR);
  void Inverse_Left_Motor(int DIR);
  void Output_K_PID(struct Kinematic* Kine, struct Para_Mobile_Robot* Ro, struct Para_Motor* MR, struct Para_Motor* ML, struct PID_XY* Pos, struct PID_XY* Anguler);
  void Forward_Kinematic(struct Kinematic* pt_Kine, struct Para_Mobile_Robot* pt_Robot, struct Para_Motor* pt_Para_MR, struct Para_Motor* pt_Para_ML);
  void UART_1(float a1, float a2, float a3, float a4, float a5, float a6);
  float FC_1(float x);
  void Path_planing(float Tap_diem_x[], float Tap_diem_y[], float Mang_Robot[2][2], struct Possision_Input* pos, struct Kinematic* Kine, uint32_t Vi_tri);
  float Tam_xuat(float Da_thuc[2][2]);
  void Stepper(float Khoang_cach_mm);
  void DIR_Servo(int8_t DIR);
  void HAL_TIM_PWM_PulseFinishedCallback(TIM_HandleTypeDef *htim);
  void HAL_I2C_SlaveRxCpltCallback(I2C_HandleTypeDef *hi2c);
  void HAL_I2C_AddrCallback(I2C_HandleTypeDef*hi2c,uint8_t TransferDirection,uint16_t AddrMatchCode);



//  uint16_t Size = sizeof(AX)/sizeof(float);
//  for(int i = 0; i<Size; i++)
//  {
//	  AX[i] = AX[i]*1000;
//	  AY[i] = AY[i]*1000;
//  }

  // Khởi tạo
  Initial_Mobile_Robot(pt_Robot);
  Initial_PID_XY(pt_PID_posision, pt_PID_theta);
  pt_Kine->V_Set = 0.05;
  pt_Kine->Theta_Real_Robot = 1.57;

  HAL_I2C_SlaveRxCpltCallback(&hi2c1);
  HAL_TIM_Base_Start_IT(&htim8);  // Timer cho PID DC Motor
  HAL_TIM_Base_Start_IT(&htim6); // Timer Global
  HAL_TIM_Base_Start_IT(&htim10); // Timer Stepper
  HAL_TIM_Base_Start_IT(&htim11); // Timer Init

  HAL_TIM_Encoder_Start_IT(&htim3, TIM_CHANNEL_1 && TIM_CHANNEL_2);
  HAL_TIM_Encoder_Start_IT(&htim4, TIM_CHANNEL_1 && TIM_CHANNEL_2);

  HAL_TIM_PWM_Start_IT(&htim5, TIM_CHANNEL_1);

  HAL_TIM_PWM_Start(&htim2, TIM_CHANNEL_1);
  HAL_TIM_PWM_Start(&htim1, TIM_CHANNEL_1);

//  pt_Para_MR->SP_Rad_s = 1.5;
//    pt_Para_ML->SP_Rad_s = 1.5;
//  Inverse_Right_Motor(0);
//  Inverse_Left_Motor(0);


  /* USER CODE END 2 */

  /* Infinite loop */
  /* USER CODE BEGIN WHILE */
  while (1)
  {
    /* USER CODE END WHILE */

    /* USER CODE BEGIN 3 */



	  OUT_01[1] = -1*o1;
	  OUT_01[3] = o1;
	     // Xuất xung PWM PID
//	     __HAL_TIM_SET_COMPARE(&htim2, TIM_CHANNEL_1, pt_Para_MR->Out_PWM);
//	     __HAL_TIM_SET_COMPARE(&htim1, TIM_CHANNEL_1, pt_Para_ML->Out_PWM);
//	  Size_Data = sizeof(Data_001);
//	  HAL_UART_Transmit(&huart2, Data_001, Size_Data, 100);
	  EX = pt_pos_1->x - pt_Kine->X_real;
	  EY = pt_pos_1->y - pt_Kine->Y_real;
	  E_Velocity = pt_Kine->V_Set - pt_Kine->V_real;
	  Error_Distance = sqrt(pow(EX,2) + pow(EX,2));
	  //UART_1(pt_Kine->V_Set, pt_Kine->V_real,pt_pos_1->x, pt_pos_1->y, pt_Kine->X_Welding, pt_Kine->Y_Welding);
	  UART_1(Mang_Robot_1[0][0], Mang_Robot_1[0][1], pt_pos_1->x, pt_pos_1->y , pt_Kine->X_Welding, pt_Kine->Y_Welding);
	  //UART_1(EX, EY, EV);

	  //Stepper(Khoang_cach_mm_1);

//	  // Oled
//		ssd1306_Fill(Black);
//		a_float = 3.0;
//		// Format Oled
//		sprintf(str10, "%.2f", a_float);
//		ssd1306_SetCursor(25, 0);
//		ssd1306_WriteString("Do an Co Dien Tu", Font_7x10, White);
//		ssd1306_Line(25, 10, ax1, ay1, White);
//		// Toa do X
//		ssd1306_SetCursor(0, 20);
//		ssd1306_WriteString("X: ", Font_6x8, White);
//		ssd1306_SetCursor(6*3, 20);
//		ssd1306_WriteString(str10, Font_6x8, White);
//		// Toa do Y
//		ssd1306_SetCursor(0, 28);
//		ssd1306_WriteString("Y: ", Font_6x8, White);
//		ssd1306_SetCursor(6*3, 28);
//		ssd1306_WriteString(str10, Font_6x8, White);
//		// Goc Theta
//		ssd1306_SetCursor(0, 36);
//		ssd1306_WriteString("Theta: ", Font_6x8, White);
//		ssd1306_SetCursor(6*7, 36);
//		ssd1306_WriteString(str10, Font_6x8, White);
//		ssd1306_UpdateScreen();


	  HAL_Delay(50);

  }
  /* USER CODE END 3 */
}

/**
  * @brief System Clock Configuration
  * @retval None
  */
void SystemClock_Config(void)
{
  RCC_OscInitTypeDef RCC_OscInitStruct = {0};
  RCC_ClkInitTypeDef RCC_ClkInitStruct = {0};

  /** Configure the main internal regulator output voltage
  */
  __HAL_RCC_PWR_CLK_ENABLE();
  __HAL_PWR_VOLTAGESCALING_CONFIG(PWR_REGULATOR_VOLTAGE_SCALE1);

  /** Initializes the RCC Oscillators according to the specified parameters
  * in the RCC_OscInitTypeDef structure.
  */
  RCC_OscInitStruct.OscillatorType = RCC_OSCILLATORTYPE_HSE;
  RCC_OscInitStruct.HSEState = RCC_HSE_ON;
  RCC_OscInitStruct.PLL.PLLState = RCC_PLL_ON;
  RCC_OscInitStruct.PLL.PLLSource = RCC_PLLSOURCE_HSE;
  RCC_OscInitStruct.PLL.PLLM = 4;
  RCC_OscInitStruct.PLL.PLLN = 144;
  RCC_OscInitStruct.PLL.PLLP = RCC_PLLP_DIV2;
  RCC_OscInitStruct.PLL.PLLQ = 4;
  if (HAL_RCC_OscConfig(&RCC_OscInitStruct) != HAL_OK)
  {
    Error_Handler();
  }

  /** Initializes the CPU, AHB and APB buses clocks
  */
  RCC_ClkInitStruct.ClockType = RCC_CLOCKTYPE_HCLK|RCC_CLOCKTYPE_SYSCLK
                              |RCC_CLOCKTYPE_PCLK1|RCC_CLOCKTYPE_PCLK2;
  RCC_ClkInitStruct.SYSCLKSource = RCC_SYSCLKSOURCE_PLLCLK;
  RCC_ClkInitStruct.AHBCLKDivider = RCC_SYSCLK_DIV1;
  RCC_ClkInitStruct.APB1CLKDivider = RCC_HCLK_DIV4;
  RCC_ClkInitStruct.APB2CLKDivider = RCC_HCLK_DIV2;

  if (HAL_RCC_ClockConfig(&RCC_ClkInitStruct, FLASH_LATENCY_4) != HAL_OK)
  {
    Error_Handler();
  }
}

/**
  * @brief I2C1 Initialization Function
  * @param None
  * @retval None
  */
static void MX_I2C1_Init(void)
{

  /* USER CODE BEGIN I2C1_Init 0 */

  /* USER CODE END I2C1_Init 0 */

  /* USER CODE BEGIN I2C1_Init 1 */

  /* USER CODE END I2C1_Init 1 */
  hi2c1.Instance = I2C1;
  hi2c1.Init.ClockSpeed = 400000;
  hi2c1.Init.DutyCycle = I2C_DUTYCYCLE_2;
  hi2c1.Init.OwnAddress1 = 36;
  hi2c1.Init.AddressingMode = I2C_ADDRESSINGMODE_7BIT;
  hi2c1.Init.DualAddressMode = I2C_DUALADDRESS_DISABLE;
  hi2c1.Init.OwnAddress2 = 0;
  hi2c1.Init.GeneralCallMode = I2C_GENERALCALL_DISABLE;
  hi2c1.Init.NoStretchMode = I2C_NOSTRETCH_DISABLE;
  if (HAL_I2C_Init(&hi2c1) != HAL_OK)
  {
    Error_Handler();
  }
  /* USER CODE BEGIN I2C1_Init 2 */

  /* USER CODE END I2C1_Init 2 */

}

/**
  * @brief I2C2 Initialization Function
  * @param None
  * @retval None
  */
static void MX_I2C2_Init(void)
{

  /* USER CODE BEGIN I2C2_Init 0 */

  /* USER CODE END I2C2_Init 0 */

  /* USER CODE BEGIN I2C2_Init 1 */

  /* USER CODE END I2C2_Init 1 */
  hi2c2.Instance = I2C2;
  hi2c2.Init.ClockSpeed = 100000;
  hi2c2.Init.DutyCycle = I2C_DUTYCYCLE_2;
  hi2c2.Init.OwnAddress1 = 0;
  hi2c2.Init.AddressingMode = I2C_ADDRESSINGMODE_7BIT;
  hi2c2.Init.DualAddressMode = I2C_DUALADDRESS_DISABLE;
  hi2c2.Init.OwnAddress2 = 0;
  hi2c2.Init.GeneralCallMode = I2C_GENERALCALL_DISABLE;
  hi2c2.Init.NoStretchMode = I2C_NOSTRETCH_DISABLE;
  if (HAL_I2C_Init(&hi2c2) != HAL_OK)
  {
    Error_Handler();
  }
  /* USER CODE BEGIN I2C2_Init 2 */

  /* USER CODE END I2C2_Init 2 */

}

/**
  * @brief SPI1 Initialization Function
  * @param None
  * @retval None
  */
static void MX_SPI1_Init(void)
{

  /* USER CODE BEGIN SPI1_Init 0 */

  /* USER CODE END SPI1_Init 0 */

  /* USER CODE BEGIN SPI1_Init 1 */

  /* USER CODE END SPI1_Init 1 */
  /* SPI1 parameter configuration*/
  hspi1.Instance = SPI1;
  hspi1.Init.Mode = SPI_MODE_MASTER;
  hspi1.Init.Direction = SPI_DIRECTION_2LINES;
  hspi1.Init.DataSize = SPI_DATASIZE_8BIT;
  hspi1.Init.CLKPolarity = SPI_POLARITY_LOW;
  hspi1.Init.CLKPhase = SPI_PHASE_1EDGE;
  hspi1.Init.NSS = SPI_NSS_SOFT;
  hspi1.Init.BaudRatePrescaler = SPI_BAUDRATEPRESCALER_2;
  hspi1.Init.FirstBit = SPI_FIRSTBIT_MSB;
  hspi1.Init.TIMode = SPI_TIMODE_DISABLE;
  hspi1.Init.CRCCalculation = SPI_CRCCALCULATION_DISABLE;
  hspi1.Init.CRCPolynomial = 10;
  if (HAL_SPI_Init(&hspi1) != HAL_OK)
  {
    Error_Handler();
  }
  /* USER CODE BEGIN SPI1_Init 2 */

  /* USER CODE END SPI1_Init 2 */

}

/**
  * @brief TIM1 Initialization Function
  * @param None
  * @retval None
  */
static void MX_TIM1_Init(void)
{

  /* USER CODE BEGIN TIM1_Init 0 */

  /* USER CODE END TIM1_Init 0 */

  TIM_MasterConfigTypeDef sMasterConfig = {0};
  TIM_OC_InitTypeDef sConfigOC = {0};
  TIM_BreakDeadTimeConfigTypeDef sBreakDeadTimeConfig = {0};

  /* USER CODE BEGIN TIM1_Init 1 */

  /* USER CODE END TIM1_Init 1 */
  htim1.Instance = TIM1;
  htim1.Init.Prescaler = 6;
  htim1.Init.CounterMode = TIM_COUNTERMODE_UP;
  htim1.Init.Period = 999;
  htim1.Init.ClockDivision = TIM_CLOCKDIVISION_DIV1;
  htim1.Init.RepetitionCounter = 0;
  htim1.Init.AutoReloadPreload = TIM_AUTORELOAD_PRELOAD_DISABLE;
  if (HAL_TIM_PWM_Init(&htim1) != HAL_OK)
  {
    Error_Handler();
  }
  sMasterConfig.MasterOutputTrigger = TIM_TRGO_RESET;
  sMasterConfig.MasterSlaveMode = TIM_MASTERSLAVEMODE_DISABLE;
  if (HAL_TIMEx_MasterConfigSynchronization(&htim1, &sMasterConfig) != HAL_OK)
  {
    Error_Handler();
  }
  sConfigOC.OCMode = TIM_OCMODE_PWM1;
  sConfigOC.Pulse = 0;
  sConfigOC.OCPolarity = TIM_OCPOLARITY_HIGH;
  sConfigOC.OCNPolarity = TIM_OCNPOLARITY_HIGH;
  sConfigOC.OCFastMode = TIM_OCFAST_DISABLE;
  sConfigOC.OCIdleState = TIM_OCIDLESTATE_RESET;
  sConfigOC.OCNIdleState = TIM_OCNIDLESTATE_RESET;
  if (HAL_TIM_PWM_ConfigChannel(&htim1, &sConfigOC, TIM_CHANNEL_1) != HAL_OK)
  {
    Error_Handler();
  }
  sBreakDeadTimeConfig.OffStateRunMode = TIM_OSSR_DISABLE;
  sBreakDeadTimeConfig.OffStateIDLEMode = TIM_OSSI_DISABLE;
  sBreakDeadTimeConfig.LockLevel = TIM_LOCKLEVEL_OFF;
  sBreakDeadTimeConfig.DeadTime = 0;
  sBreakDeadTimeConfig.BreakState = TIM_BREAK_DISABLE;
  sBreakDeadTimeConfig.BreakPolarity = TIM_BREAKPOLARITY_HIGH;
  sBreakDeadTimeConfig.AutomaticOutput = TIM_AUTOMATICOUTPUT_DISABLE;
  if (HAL_TIMEx_ConfigBreakDeadTime(&htim1, &sBreakDeadTimeConfig) != HAL_OK)
  {
    Error_Handler();
  }
  /* USER CODE BEGIN TIM1_Init 2 */

  /* USER CODE END TIM1_Init 2 */
  HAL_TIM_MspPostInit(&htim1);

}

/**
  * @brief TIM2 Initialization Function
  * @param None
  * @retval None
  */
static void MX_TIM2_Init(void)
{

  /* USER CODE BEGIN TIM2_Init 0 */

  /* USER CODE END TIM2_Init 0 */

  TIM_MasterConfigTypeDef sMasterConfig = {0};
  TIM_OC_InitTypeDef sConfigOC = {0};

  /* USER CODE BEGIN TIM2_Init 1 */

  /* USER CODE END TIM2_Init 1 */
  htim2.Instance = TIM2;
  htim2.Init.Prescaler = 6;
  htim2.Init.CounterMode = TIM_COUNTERMODE_UP;
  htim2.Init.Period = 999;
  htim2.Init.ClockDivision = TIM_CLOCKDIVISION_DIV1;
  htim2.Init.AutoReloadPreload = TIM_AUTORELOAD_PRELOAD_DISABLE;
  if (HAL_TIM_PWM_Init(&htim2) != HAL_OK)
  {
    Error_Handler();
  }
  sMasterConfig.MasterOutputTrigger = TIM_TRGO_RESET;
  sMasterConfig.MasterSlaveMode = TIM_MASTERSLAVEMODE_DISABLE;
  if (HAL_TIMEx_MasterConfigSynchronization(&htim2, &sMasterConfig) != HAL_OK)
  {
    Error_Handler();
  }
  sConfigOC.OCMode = TIM_OCMODE_PWM1;
  sConfigOC.Pulse = 0;
  sConfigOC.OCPolarity = TIM_OCPOLARITY_HIGH;
  sConfigOC.OCFastMode = TIM_OCFAST_DISABLE;
  if (HAL_TIM_PWM_ConfigChannel(&htim2, &sConfigOC, TIM_CHANNEL_1) != HAL_OK)
  {
    Error_Handler();
  }
  /* USER CODE BEGIN TIM2_Init 2 */

  /* USER CODE END TIM2_Init 2 */
  HAL_TIM_MspPostInit(&htim2);

}

/**
  * @brief TIM3 Initialization Function
  * @param None
  * @retval None
  */
static void MX_TIM3_Init(void)
{

  /* USER CODE BEGIN TIM3_Init 0 */

  /* USER CODE END TIM3_Init 0 */

  TIM_Encoder_InitTypeDef sConfig = {0};
  TIM_MasterConfigTypeDef sMasterConfig = {0};

  /* USER CODE BEGIN TIM3_Init 1 */

  /* USER CODE END TIM3_Init 1 */
  htim3.Instance = TIM3;
  htim3.Init.Prescaler = 0;
  htim3.Init.CounterMode = TIM_COUNTERMODE_UP;
  htim3.Init.Period = 65535;
  htim3.Init.ClockDivision = TIM_CLOCKDIVISION_DIV1;
  htim3.Init.AutoReloadPreload = TIM_AUTORELOAD_PRELOAD_DISABLE;
  sConfig.EncoderMode = TIM_ENCODERMODE_TI12;
  sConfig.IC1Polarity = TIM_ICPOLARITY_RISING;
  sConfig.IC1Selection = TIM_ICSELECTION_DIRECTTI;
  sConfig.IC1Prescaler = TIM_ICPSC_DIV1;
  sConfig.IC1Filter = 0;
  sConfig.IC2Polarity = TIM_ICPOLARITY_RISING;
  sConfig.IC2Selection = TIM_ICSELECTION_DIRECTTI;
  sConfig.IC2Prescaler = TIM_ICPSC_DIV1;
  sConfig.IC2Filter = 0;
  if (HAL_TIM_Encoder_Init(&htim3, &sConfig) != HAL_OK)
  {
    Error_Handler();
  }
  sMasterConfig.MasterOutputTrigger = TIM_TRGO_RESET;
  sMasterConfig.MasterSlaveMode = TIM_MASTERSLAVEMODE_DISABLE;
  if (HAL_TIMEx_MasterConfigSynchronization(&htim3, &sMasterConfig) != HAL_OK)
  {
    Error_Handler();
  }
  /* USER CODE BEGIN TIM3_Init 2 */

  /* USER CODE END TIM3_Init 2 */

}

/**
  * @brief TIM4 Initialization Function
  * @param None
  * @retval None
  */
static void MX_TIM4_Init(void)
{

  /* USER CODE BEGIN TIM4_Init 0 */

  /* USER CODE END TIM4_Init 0 */

  TIM_Encoder_InitTypeDef sConfig = {0};
  TIM_MasterConfigTypeDef sMasterConfig = {0};

  /* USER CODE BEGIN TIM4_Init 1 */

  /* USER CODE END TIM4_Init 1 */
  htim4.Instance = TIM4;
  htim4.Init.Prescaler = 0;
  htim4.Init.CounterMode = TIM_COUNTERMODE_UP;
  htim4.Init.Period = 65535;
  htim4.Init.ClockDivision = TIM_CLOCKDIVISION_DIV1;
  htim4.Init.AutoReloadPreload = TIM_AUTORELOAD_PRELOAD_DISABLE;
  sConfig.EncoderMode = TIM_ENCODERMODE_TI12;
  sConfig.IC1Polarity = TIM_ICPOLARITY_RISING;
  sConfig.IC1Selection = TIM_ICSELECTION_DIRECTTI;
  sConfig.IC1Prescaler = TIM_ICPSC_DIV1;
  sConfig.IC1Filter = 0;
  sConfig.IC2Polarity = TIM_ICPOLARITY_RISING;
  sConfig.IC2Selection = TIM_ICSELECTION_DIRECTTI;
  sConfig.IC2Prescaler = TIM_ICPSC_DIV1;
  sConfig.IC2Filter = 0;
  if (HAL_TIM_Encoder_Init(&htim4, &sConfig) != HAL_OK)
  {
    Error_Handler();
  }
  sMasterConfig.MasterOutputTrigger = TIM_TRGO_RESET;
  sMasterConfig.MasterSlaveMode = TIM_MASTERSLAVEMODE_DISABLE;
  if (HAL_TIMEx_MasterConfigSynchronization(&htim4, &sMasterConfig) != HAL_OK)
  {
    Error_Handler();
  }
  /* USER CODE BEGIN TIM4_Init 2 */

  /* USER CODE END TIM4_Init 2 */

}

/**
  * @brief TIM5 Initialization Function
  * @param None
  * @retval None
  */
static void MX_TIM5_Init(void)
{

  /* USER CODE BEGIN TIM5_Init 0 */

  /* USER CODE END TIM5_Init 0 */

  TIM_MasterConfigTypeDef sMasterConfig = {0};
  TIM_OC_InitTypeDef sConfigOC = {0};

  /* USER CODE BEGIN TIM5_Init 1 */

  /* USER CODE END TIM5_Init 1 */
  htim5.Instance = TIM5;
  htim5.Init.Prescaler = 2057;
  htim5.Init.CounterMode = TIM_COUNTERMODE_UP;
  htim5.Init.Period = 99;
  htim5.Init.ClockDivision = TIM_CLOCKDIVISION_DIV1;
  htim5.Init.AutoReloadPreload = TIM_AUTORELOAD_PRELOAD_DISABLE;
  if (HAL_TIM_PWM_Init(&htim5) != HAL_OK)
  {
    Error_Handler();
  }
  sMasterConfig.MasterOutputTrigger = TIM_TRGO_RESET;
  sMasterConfig.MasterSlaveMode = TIM_MASTERSLAVEMODE_DISABLE;
  if (HAL_TIMEx_MasterConfigSynchronization(&htim5, &sMasterConfig) != HAL_OK)
  {
    Error_Handler();
  }
  sConfigOC.OCMode = TIM_OCMODE_PWM1;
  sConfigOC.Pulse = 0;
  sConfigOC.OCPolarity = TIM_OCPOLARITY_HIGH;
  sConfigOC.OCFastMode = TIM_OCFAST_DISABLE;
  if (HAL_TIM_PWM_ConfigChannel(&htim5, &sConfigOC, TIM_CHANNEL_1) != HAL_OK)
  {
    Error_Handler();
  }
  /* USER CODE BEGIN TIM5_Init 2 */

  /* USER CODE END TIM5_Init 2 */
  HAL_TIM_MspPostInit(&htim5);

}

/**
  * @brief TIM6 Initialization Function
  * @param None
  * @retval None
  */
static void MX_TIM6_Init(void)
{

  /* USER CODE BEGIN TIM6_Init 0 */

  /* USER CODE END TIM6_Init 0 */

  TIM_MasterConfigTypeDef sMasterConfig = {0};

  /* USER CODE BEGIN TIM6_Init 1 */

  /* USER CODE END TIM6_Init 1 */
  htim6.Instance = TIM6;
  htim6.Init.Prescaler = 1439;
  htim6.Init.CounterMode = TIM_COUNTERMODE_UP;
  htim6.Init.Period = 4999;
  htim6.Init.AutoReloadPreload = TIM_AUTORELOAD_PRELOAD_DISABLE;
  if (HAL_TIM_Base_Init(&htim6) != HAL_OK)
  {
    Error_Handler();
  }
  sMasterConfig.MasterOutputTrigger = TIM_TRGO_RESET;
  sMasterConfig.MasterSlaveMode = TIM_MASTERSLAVEMODE_DISABLE;
  if (HAL_TIMEx_MasterConfigSynchronization(&htim6, &sMasterConfig) != HAL_OK)
  {
    Error_Handler();
  }
  /* USER CODE BEGIN TIM6_Init 2 */

  /* USER CODE END TIM6_Init 2 */

}

/**
  * @brief TIM8 Initialization Function
  * @param None
  * @retval None
  */
static void MX_TIM8_Init(void)
{

  /* USER CODE BEGIN TIM8_Init 0 */

  /* USER CODE END TIM8_Init 0 */

  TIM_ClockConfigTypeDef sClockSourceConfig = {0};
  TIM_MasterConfigTypeDef sMasterConfig = {0};

  /* USER CODE BEGIN TIM8_Init 1 */

  /* USER CODE END TIM8_Init 1 */
  htim8.Instance = TIM8;
  htim8.Init.Prescaler = 1439;
  htim8.Init.CounterMode = TIM_COUNTERMODE_UP;
  htim8.Init.Period = 499;
  htim8.Init.ClockDivision = TIM_CLOCKDIVISION_DIV1;
  htim8.Init.RepetitionCounter = 0;
  htim8.Init.AutoReloadPreload = TIM_AUTORELOAD_PRELOAD_DISABLE;
  if (HAL_TIM_Base_Init(&htim8) != HAL_OK)
  {
    Error_Handler();
  }
  sClockSourceConfig.ClockSource = TIM_CLOCKSOURCE_INTERNAL;
  if (HAL_TIM_ConfigClockSource(&htim8, &sClockSourceConfig) != HAL_OK)
  {
    Error_Handler();
  }
  sMasterConfig.MasterOutputTrigger = TIM_TRGO_RESET;
  sMasterConfig.MasterSlaveMode = TIM_MASTERSLAVEMODE_DISABLE;
  if (HAL_TIMEx_MasterConfigSynchronization(&htim8, &sMasterConfig) != HAL_OK)
  {
    Error_Handler();
  }
  /* USER CODE BEGIN TIM8_Init 2 */

  /* USER CODE END TIM8_Init 2 */

}

/**
  * @brief TIM9 Initialization Function
  * @param None
  * @retval None
  */
static void MX_TIM9_Init(void)
{

  /* USER CODE BEGIN TIM9_Init 0 */

  /* USER CODE END TIM9_Init 0 */

  TIM_ClockConfigTypeDef sClockSourceConfig = {0};

  /* USER CODE BEGIN TIM9_Init 1 */

  /* USER CODE END TIM9_Init 1 */
  htim9.Instance = TIM9;
  htim9.Init.Prescaler = 0;
  htim9.Init.CounterMode = TIM_COUNTERMODE_UP;
  htim9.Init.Period = 65535;
  htim9.Init.ClockDivision = TIM_CLOCKDIVISION_DIV1;
  htim9.Init.AutoReloadPreload = TIM_AUTORELOAD_PRELOAD_DISABLE;
  if (HAL_TIM_Base_Init(&htim9) != HAL_OK)
  {
    Error_Handler();
  }
  sClockSourceConfig.ClockSource = TIM_CLOCKSOURCE_INTERNAL;
  if (HAL_TIM_ConfigClockSource(&htim9, &sClockSourceConfig) != HAL_OK)
  {
    Error_Handler();
  }
  /* USER CODE BEGIN TIM9_Init 2 */

  /* USER CODE END TIM9_Init 2 */

}

/**
  * @brief TIM10 Initialization Function
  * @param None
  * @retval None
  */
static void MX_TIM10_Init(void)
{

  /* USER CODE BEGIN TIM10_Init 0 */

  /* USER CODE END TIM10_Init 0 */

  /* USER CODE BEGIN TIM10_Init 1 */

  /* USER CODE END TIM10_Init 1 */
  htim10.Instance = TIM10;
  htim10.Init.Prescaler = 1439;
  htim10.Init.CounterMode = TIM_COUNTERMODE_UP;
  htim10.Init.Period = 19999;
  htim10.Init.ClockDivision = TIM_CLOCKDIVISION_DIV1;
  htim10.Init.AutoReloadPreload = TIM_AUTORELOAD_PRELOAD_DISABLE;
  if (HAL_TIM_Base_Init(&htim10) != HAL_OK)
  {
    Error_Handler();
  }
  /* USER CODE BEGIN TIM10_Init 2 */

  /* USER CODE END TIM10_Init 2 */

}

/**
  * @brief TIM11 Initialization Function
  * @param None
  * @retval None
  */
static void MX_TIM11_Init(void)
{

  /* USER CODE BEGIN TIM11_Init 0 */

  /* USER CODE END TIM11_Init 0 */

  /* USER CODE BEGIN TIM11_Init 1 */

  /* USER CODE END TIM11_Init 1 */
  htim11.Instance = TIM11;
  htim11.Init.Prescaler = 1440;
  htim11.Init.CounterMode = TIM_COUNTERMODE_UP;
  htim11.Init.Period = 999;
  htim11.Init.ClockDivision = TIM_CLOCKDIVISION_DIV1;
  htim11.Init.AutoReloadPreload = TIM_AUTORELOAD_PRELOAD_DISABLE;
  if (HAL_TIM_Base_Init(&htim11) != HAL_OK)
  {
    Error_Handler();
  }
  /* USER CODE BEGIN TIM11_Init 2 */

  /* USER CODE END TIM11_Init 2 */

}

/**
  * @brief USART1 Initialization Function
  * @param None
  * @retval None
  */
static void MX_USART1_UART_Init(void)
{

  /* USER CODE BEGIN USART1_Init 0 */

  /* USER CODE END USART1_Init 0 */

  /* USER CODE BEGIN USART1_Init 1 */

  /* USER CODE END USART1_Init 1 */
  huart1.Instance = USART1;
  huart1.Init.BaudRate = 9600;
  huart1.Init.WordLength = UART_WORDLENGTH_8B;
  huart1.Init.StopBits = UART_STOPBITS_1;
  huart1.Init.Parity = UART_PARITY_NONE;
  huart1.Init.Mode = UART_MODE_TX_RX;
  huart1.Init.HwFlowCtl = UART_HWCONTROL_NONE;
  huart1.Init.OverSampling = UART_OVERSAMPLING_16;
  if (HAL_UART_Init(&huart1) != HAL_OK)
  {
    Error_Handler();
  }
  /* USER CODE BEGIN USART1_Init 2 */

  /* USER CODE END USART1_Init 2 */

}

/**
  * @brief USART2 Initialization Function
  * @param None
  * @retval None
  */
static void MX_USART2_UART_Init(void)
{

  /* USER CODE BEGIN USART2_Init 0 */

  /* USER CODE END USART2_Init 0 */

  /* USER CODE BEGIN USART2_Init 1 */

  /* USER CODE END USART2_Init 1 */
  huart2.Instance = USART2;
  huart2.Init.BaudRate = 9600;
  huart2.Init.WordLength = UART_WORDLENGTH_8B;
  huart2.Init.StopBits = UART_STOPBITS_1;
  huart2.Init.Parity = UART_PARITY_NONE;
  huart2.Init.Mode = UART_MODE_TX_RX;
  huart2.Init.HwFlowCtl = UART_HWCONTROL_NONE;
  huart2.Init.OverSampling = UART_OVERSAMPLING_16;
  if (HAL_UART_Init(&huart2) != HAL_OK)
  {
    Error_Handler();
  }
  /* USER CODE BEGIN USART2_Init 2 */

  /* USER CODE END USART2_Init 2 */

}

/**
  * @brief GPIO Initialization Function
  * @param None
  * @retval None
  */
static void MX_GPIO_Init(void)
{
  GPIO_InitTypeDef GPIO_InitStruct = {0};
/* USER CODE BEGIN MX_GPIO_Init_1 */
/* USER CODE END MX_GPIO_Init_1 */

  /* GPIO Ports Clock Enable */
  __HAL_RCC_GPIOE_CLK_ENABLE();
  __HAL_RCC_GPIOH_CLK_ENABLE();
  __HAL_RCC_GPIOC_CLK_ENABLE();
  __HAL_RCC_GPIOA_CLK_ENABLE();
  __HAL_RCC_GPIOB_CLK_ENABLE();
  __HAL_RCC_GPIOD_CLK_ENABLE();

  /*Configure GPIO pin Output Level */
  HAL_GPIO_WritePin(GPIOE, RUN_LIGHT_Pin|STOP_LIGHT_Pin|WARNING_LIGHT_Pin|GPIO_PIN_15, GPIO_PIN_RESET);

  /*Configure GPIO pin Output Level */
  HAL_GPIO_WritePin(GPIOC, GPIO_PIN_0|GPIO_PIN_1|GPIO_PIN_2|GPIO_PIN_3, GPIO_PIN_RESET);

  /*Configure GPIO pin Output Level */
  HAL_GPIO_WritePin(GPIOD, DIR_L_Pin|DIR_R_Pin|DIR_SERVO_Pin, GPIO_PIN_RESET);

  /*Configure GPIO pins : RUN_LIGHT_Pin STOP_LIGHT_Pin WARNING_LIGHT_Pin */
  GPIO_InitStruct.Pin = RUN_LIGHT_Pin|STOP_LIGHT_Pin|WARNING_LIGHT_Pin;
  GPIO_InitStruct.Mode = GPIO_MODE_OUTPUT_PP;
  GPIO_InitStruct.Pull = GPIO_NOPULL;
  GPIO_InitStruct.Speed = GPIO_SPEED_FREQ_LOW;
  HAL_GPIO_Init(GPIOE, &GPIO_InitStruct);

  /*Configure GPIO pins : PC0 PC1 PC2 PC3 */
  GPIO_InitStruct.Pin = GPIO_PIN_0|GPIO_PIN_1|GPIO_PIN_2|GPIO_PIN_3;
  GPIO_InitStruct.Mode = GPIO_MODE_OUTPUT_PP;
  GPIO_InitStruct.Pull = GPIO_NOPULL;
  GPIO_InitStruct.Speed = GPIO_SPEED_FREQ_LOW;
  HAL_GPIO_Init(GPIOC, &GPIO_InitStruct);

  /*Configure GPIO pin : PE15 */
  GPIO_InitStruct.Pin = GPIO_PIN_15;
  GPIO_InitStruct.Mode = GPIO_MODE_OUTPUT_PP;
  GPIO_InitStruct.Pull = GPIO_NOPULL;
  GPIO_InitStruct.Speed = GPIO_SPEED_FREQ_VERY_HIGH;
  HAL_GPIO_Init(GPIOE, &GPIO_InitStruct);

  /*Configure GPIO pins : USER_BUTTON_Pin STOP_Button_Pin START_Button_Pin */
  GPIO_InitStruct.Pin = USER_BUTTON_Pin|STOP_Button_Pin|START_Button_Pin;
  GPIO_InitStruct.Mode = GPIO_MODE_INPUT;
  GPIO_InitStruct.Pull = GPIO_NOPULL;
  HAL_GPIO_Init(GPIOD, &GPIO_InitStruct);

  /*Configure GPIO pins : DIR_L_Pin DIR_R_Pin DIR_SERVO_Pin */
  GPIO_InitStruct.Pin = DIR_L_Pin|DIR_R_Pin|DIR_SERVO_Pin;
  GPIO_InitStruct.Mode = GPIO_MODE_OUTPUT_PP;
  GPIO_InitStruct.Pull = GPIO_NOPULL;
  GPIO_InitStruct.Speed = GPIO_SPEED_FREQ_LOW;
  HAL_GPIO_Init(GPIOD, &GPIO_InitStruct);

/* USER CODE BEGIN MX_GPIO_Init_2 */
/* USER CODE END MX_GPIO_Init_2 */
}

/* USER CODE BEGIN 4 */
// Stepper
void DIR_Servo(int8_t DIR)
{
	if(DIR == 1)
	{
		HAL_GPIO_WritePin(GPIOD, GPIO_PIN_7, SET);
	}
	else if(DIR == -1)
	{
		HAL_GPIO_WritePin(GPIOD, GPIO_PIN_7, RESET);
	}

}

// Ham_dem_xung_Serrvo
void HAL_TIM_PWM_PulseFinishedCallback(TIM_HandleTypeDef *htim)
{
	if(htim->Instance == TIM5)
	{
		if(Counter_AC == Diem_dung)
		{
			__HAL_TIM_SET_COMPARE(&htim5, TIM_CHANNEL_1, 0);
		}
		else if(Counter_AC < Diem_dung)
		{
			DIR = 1;
			DIR_Servo(DIR);
			__HAL_TIM_SET_COMPARE(&htim5, TIM_CHANNEL_1, 49);
			Counter_AC+=1;
		}
		else if(Counter_AC > Diem_dung)
		{
			DIR = -1;
			__HAL_TIM_SET_COMPARE(&htim5, TIM_CHANNEL_1, 49);
			DIR_Servo(DIR);
			Counter_AC-=1;
		}
	}
}

void Stepper(float Khoang_cach_mm)
{
	float phan_giai = 1;
	float Buoc_ren = 4;  // Bước 4
	Diem_dung = (int32_t)(Khoang_cach_mm*200*phan_giai)/(Buoc_ren);
}
// Duy Nhat
void UART_1(float a1, float a2, float a3, float a4, float a5, float a6)
{
    //a1 = sin(t) + t ;
    // Giới hạn giá trị chỉ với 4 chữ số sau dấu chấm thập phân
    int integer_part1 = (int)a1;
    float decimal_part1 = a1 - integer_part1; // Lấy phần thập phân
    decimal_part1 *= 10000000; // Dịch chuyển phần thập phân sang trái 4 chữ số
    int truncated_decimal1 = (int)decimal_part1; // Chuyển phần thập phân đã dịch chuyển thành số nguyên
     b1 = integer_part1 + truncated_decimal1 / 10000000.0; // Kết hợp lại phần nguyên và phần thập phân đã cắt


     //a2 = 10 + sin(t) + t ;
     int integer_part2 = (int)a2;
     float decimal_part2 = a2 - integer_part2;
     decimal_part2 *= 10000000;
     int truncated_decimal2 = (int)decimal_part2;
      b2 = integer_part2 + truncated_decimal2 / 10000000.0;

     //a3 =10 + sin(t) + t + a ;
     int integer_part3 = (int)a3;
     float decimal_part3 = a3 - integer_part3;
     decimal_part3 *= 10000000;
     int truncated_decimal3 = (int)decimal_part3;
     b3 = integer_part3 + truncated_decimal3 / 10000000.0;

     //a4 =  sin(t) + t ;
     int integer_part4 = (int)a4;
     float decimal_part4 = a4 - integer_part4;
     decimal_part4 *= 10000000;
     int truncated_decimal4 = (int)decimal_part4;
     b4 = integer_part4 + truncated_decimal4 / 10000000.0;



     int integer_part5 = (int)a5;
     float decimal_part5 = a5 - integer_part5;
     decimal_part5 *= 10000000;
     int truncated_decimal5 = (int)decimal_part5;
     b5 = integer_part5 + truncated_decimal5 / 10000000.0;
     //b5 = c1;


     int integer_part6 = (int)a6;
     float decimal_part6 = a6 - integer_part6;
     decimal_part6 *= 10000000;
     int truncated_decimal6 = (int)decimal_part6;
     b6 = integer_part6 + truncated_decimal6 / 10000000.0;
     //b6 = c2;



    //�?ếm size của mảng trước khi gán
	 sprintf(str1, "%.7f", b1);
	 sprintf(str2, "%.7f", b2);
	 int length1 = strlen(str1);
	 int length2 = strlen(str2);

	 sprintf(str3, "%.7f", b3);
	 sprintf(str4, "%.7f", b4);
	 int length3 = strlen(str3);
	 int length4 = strlen(str4);

	 sprintf(str5, "%.7f", b5);
	 sprintf(str6, "%.7f", b6);
	 int length5 = strlen(str5);
	 int length6 = strlen(str6);

	 // lấy length vừa tính được định dạng cho chuỗi
	 char str_a1[length1], str_a2[length2];
	 sprintf(str_a1, "%.7f", b1);
	 sprintf(str_a2, "%.7f", b2);

	 char str_a3[length3], str_a4[length4];
	 sprintf(str_a3, "%.7f", b3);
	 sprintf(str_a4, "%.7f", b4);

	 char str_a5[length5], str_a6[length6];
	 sprintf(str_a5, "%.7f", b5);
	 sprintf(str_a6, "%.7f", b6);

	 // tính tổng size cho mảng data_out
	 uint16_t size_data_out = sizeof(str_a1) + sizeof(str_a2)  + sizeof(str_a3) + sizeof(str_a4)+ sizeof(str_a5) + sizeof(str_a6) + 6;


	 // ghép lần lượt các chuỗi  vào dataout
	 char data_out[size_data_out];
	 strcpy(data_out, str_a1);
	 strcat(data_out, ";");
	 strcat(data_out, str_a2);
	 strcat(data_out, ";");

	 strcat(data_out, str_a3);
	 strcat(data_out, ";");
	 strcat(data_out, str_a4);
	 strcat(data_out, ";");

	 strcat(data_out, str_a5);
	 strcat(data_out, ";");
	 strcat(data_out, str_a6);
	 strcat(data_out, ";");

	 HAL_UART_Transmit(&huart2, data_out, size_data_out , 1000);

}
// Khởi tạo thông số xe
void Initial_Mobile_Robot(struct Para_Mobile_Robot* Ro)
{
	Ro->L = 0.175; // Khoảng cách 2 bánh xe
	Ro->R = 0.145/2; // Bán kính bánh xe
//	Ro->Distance_X_tourch = 0.15;
//	Ro->Distance_Y_tourch = 0.3;
	Ro->Distance_X_tourch = 0.0;
	Ro->Distance_Y_tourch = 0.2;
}

void Initial_PID_XY(struct PID_XY* Pos, struct PID_XY* Theta)
{
	// PID1
//	// PID vị trí
//	Pos->Kp = 0.85;
//	Pos->Ki = 0.65;
//	Pos->Kd  = 8.0;
//	// PID góc tiếp tuyến
//	Theta->Kp = 0.10;
//	Theta->Ki = 0.0;
//	Theta->Kd = 0.0;

	// PID2
//	// PID vị trí
//	Pos->Kp = 0.85;
//	Pos->Ki = 1.5;
//	Pos->Kd  = 8.0;
//	// PID góc tiếp tuyến
//	Theta->Kp = 1.0;
//	Theta->Ki = 0.5;
//	Theta->Kd = 1.0;

	//PID3
//	// PID vị trí
//	Pos->Kp = 0.85;
//	Pos->Ki = 0.8;
//	Pos->Kd  = 10.0;
//	// PID góc tiếp tuyến
//	Theta->Kp = 1.0;
//	Theta->Ki = 0.8;
//	Theta->Kd = 1.0;

//	// PID vị trí
//	Pos->Kp = 0.85;
//	Pos->Ki = 0.75;
//	Pos->Kd  = 10.0;
//	// PID góc tiếp tuyến
//	Theta->Kp = 0.8;
//	Theta->Ki = 0.4;
//	Theta->Kd = 1.5;

//	// PID vị trí
//	Pos->Kp = 2.5;
//	Pos->Ki = 0.02;
//	Pos->Kd  = 10.0;
//	// PID góc tiếp tuyến
//	Theta->Kp = 1.5;
//	Theta->Ki = 0.02;
//	Theta->Kd = 1.5;

//	// PID vị trí
//	Pos->Kp = 2.5;
//	Pos->Ki = 0.02;
//	Pos->Kd  = 1.5;
//	// PID góc tiếp tuyến
//	Theta->Kp = 1.5;
//	Theta->Ki = 0.02;
//	Theta->Kd = 1.5;

//	// PID vị trí
//	Pos->Kp = 5.5;
//	Pos->Ki = 0.03;
//	Pos->Kd  = 0.89;
//	// PID góc tiếp tuyến
//	Theta->Kp = 1.5;
//	Theta->Ki = 0.00;
//	Theta->Kd = 0.5;

//		// PID vị trí
//		Pos->Kp = 5.5;
//		Pos->Ki = 0.035;
//		Pos->Kd  = 0.985;
//		// PID góc tiếp tuyến
//		Theta->Kp = 1.1;
//		Theta->Ki = 0.00;
//		Theta->Kd = 0.64;

//	// PID vị trí
//	Pos->Kp = 7.5;
//	Pos->Ki = 0.815;
//	Pos->Kd  = 15;
//	// PID góc tiếp tuyến
//	Theta->Kp = 5.5;
//	Theta->Ki = 0.00;
//	Theta->Kd = 1.64;

		// PID vị trí
		Pos->Kp = 1.5;
		Pos->Ki = 0.15;
		Pos->Kd  = 3.5;
		// PID góc tiếp tuyến
		Theta->Kp = 5.5;
		Theta->Ki = 0.00;
		Theta->Kd = 1.64;


	// Can han
//	// PID vị trí
//	Pos->Kp = 7.5;
//	Pos->Ki = 0.585;
//	Pos->Kd  = 15.0;
//	// PID góc tiếp tuyến
//	Theta->Kp = 5.5;
//	Theta->Ki = 0.00;
//	Theta->Kd = 1.64;


	Pos->High_Limit = 200.0;
	Pos->Low_Limit = -200.0;
	Theta->High_Limit = 200.0;
	Theta->Low_Limit = -200.0;
}

// DIR = 0 Forward DIR = 1 Inverse // Tamj th�?i DIR 2 chân
void Inverse_Right_Motor(int DIR)
{
	if(DIR == 0)
	{
		HAL_GPIO_WritePin(GPIOC, GPIO_PIN_0, SET);
		HAL_GPIO_WritePin(GPIOC, GPIO_PIN_1, RESET);
	}
	else if(DIR == 1)
	{
		HAL_GPIO_WritePin(GPIOC, GPIO_PIN_0, RESET);
		HAL_GPIO_WritePin(GPIOC, GPIO_PIN_1, SET);
	}
}

void Inverse_Left_Motor(int DIR)
{
	if(DIR == 0)
	{
		HAL_GPIO_WritePin(GPIOC, GPIO_PIN_2, SET);
		HAL_GPIO_WritePin(GPIOC, GPIO_PIN_3, RESET);
	}
	else if(DIR == 1)
	{
		HAL_GPIO_WritePin(GPIOC, GPIO_PIN_2, RESET);
		HAL_GPIO_WritePin(GPIOC, GPIO_PIN_3, SET);
	}
}

void Output_K_PID(struct Kinematic* Kine, struct Para_Mobile_Robot* Ro, struct Para_Motor* MR, struct Para_Motor* ML, struct PID_XY* Pos, struct PID_XY* Anguler)
{
	Output_PID_K_0 = (Pos->Output + Anguler->Output)/2.0;
	Kine->VR_Set =   Output_PID_K_0 * (Ro->L / 2.0)   + Kine->V_Set; // v1 = u1*L/2 + vconst;
	Kine->VL_Set = -(Output_PID_K_0 * (Ro->L / 2.0))  + Kine->V_Set; // v2 = -u1*L/2 + vconst;
	Kine->V_Set_1 = (Kine->VR_Set + Kine->VL_Set)/2.0;  // v = (v1+v2)/2;
	MR->SP_Rad_s = Kine->V_Set_1/Ro->R;  //wr = v1/R;
	ML->SP_Rad_s = Kine->V_Set_1/Ro->R;  // wl = v2/R
}

// �?ộng h�?c thuận
void Forward_Kinematic(struct Kinematic* pt_Kine, struct Para_Mobile_Robot* pt_Robot, struct Para_Motor* pt_Para_MR, struct Para_Motor* pt_Para_ML)
{
	/*v= (WR+WL)*0.065/2;
	w= ((WR-WL)*0.065)/(2*0.17);
	xdot_fn=v*cos(th_er);
	ydot_fn=v*sin(th_er);*/
	pt_Kine->V_real = (pt_Para_MR->Rad_s + pt_Para_ML->Rad_s)*(pt_Robot->R/2); // Tính vận tốc thực tế cho xe
	pt_Kine->W_Real = ((pt_Para_MR->Rad_s - pt_Para_ML->Rad_s)*pt_Robot->R)/(2*pt_Robot->L); // Tốc độ quay của robot hiện tại
	pt_Kine->X_dot = pt_Kine->V_real*cos(pt_Kine->Theta_Real_Robot); // x dot
	pt_Kine->Y_dot = pt_Kine->V_real*sin(pt_Kine->Theta_Real_Robot); // y dot
	// Tích phân để ra x,y hiện tại của robot
	pt_Kine->X_real = pt_Kine->X_real + pt_Kine->X_dot*Time_Interrupt; // Vị trí của robot phương X
	pt_Kine->Y_real = pt_Kine->Y_real + pt_Kine->Y_dot*Time_Interrupt; // Vị trí của robot phương Y


}

/**********************************        Path planing        *******************************/
//Quy dao mau
float FC_1(float x)
{
	float A = 0;
	//A = (5.52*pow(10,-8)*pow(x,4) - 5.456*pow(10,-5)*pow(x,3) + 0.01686*pow(x,2)- 1.783*x + 309.7)*0.5;
	//A = pow(x,2) + x -2;
	//A =2* pow(x,3) + 5*pow(x,2) + x -2;
	//**A = 0.00367052*pow(x,4) + 0.01950814*pow(x,3) - 0.21729992*pow(x,2) - 0.70247411*x + 2.06652717;
	A = 0.0222*pow(x,3) - 0.1001*pow(x,2) - 0.6718*x + 1.8095;

	return A;
}

float Tam_xuat(float Da_thuc[2][2])
{
	float He_so_a = 0;
	He_so_a = (Da_thuc[1][1] - Da_thuc[1][0])/(Da_thuc[0][1] - Da_thuc[0][0]);  // (y2-y1)/(x2-x1)
	return He_so_a;
}

// Quy dao toa do x,y
void Path_planing(float Tap_diem_x[], float Tap_diem_y[], float Mang_Robot[2][2], struct Possision_Input* pos, struct Kinematic* Kine, uint32_t Vi_tri)
{
	while(Kine->Y_Welding >= Mang_Robot[1][1])
	{
		Vi_tri = Vi_tri + 1;
		for(int i=0; i<2;i++)
		{
			// Gan lai toa do moi x,y robot se den vao mang Robot
			Mang_Robot[i][0] = Tap_diem_x[Vi_tri+i];
			Mang_Robot[i][1] = Tap_diem_y[Vi_tri+i];
		}
	}
		// Phuong trinh duong thang //* dang so sanh voi x
		float He_so_a = 0;
		if((Mang_Robot[1][0] - Mang_Robot[0][0]) == 0)
		{
			He_so_a = 1000;
		}
		else
		{
			He_so_a = (Mang_Robot[1][1] - Mang_Robot[0][1])/(Mang_Robot[1][0] - Mang_Robot[0][0]);
		}
		float Temp_Path_1 = Mang_Robot[0][1] - He_so_a*Mang_Robot[0][0]; // b = y1 - ((y2-y1)/(x2-x1))*x1

		pos->x = (Kine->Y_Welding- Temp_Path_1)/He_so_a;


		pos->y = Kine->Y_Welding;

//		// Phuong trinh duong thang //* dang vuong goc voi phuong trinh
//		float He_so_a = (Mang_Robot[1][1] - Mang_Robot[0][1])/(Mang_Robot[1][0] - Mang_Robot[0][0]);
//		float Temp_Path_1 = Mang_Robot[0][1] - He_so_a*Mang_Robot[0][0]; // b = y1 - ((y2-y1)/(x2-x1))*x1  // He so b duong thang chua 2 diem
//		float Temp_Path_2 = Kine->Y_Welding - tan(Kine->Theta_Real_Robot + PI/2)*Kine->X_Welding;  // b1 = y_robot - tan(theta + PI/2)*x_robot // He so b phuong trinh vuong goc voi robot
//		pos->x = (Temp_Path_2 - Temp_Path_1)/(He_so_a - tan(Kine->Theta_Real_Robot + PI/2));
//		pos->y = He_so_a*pos->x + Temp_Path_1;


}

// Ngat I2C Part 1: ESP32
void HAL_I2C_SlaveRxCpltCallback(I2C_HandleTypeDef *hi2c)
{
	HAL_I2C_Slave_Receive_IT(&hi2c1, RxData, RxSIZE);
    // Concatenate RxData into a single 32-bit variable
    a_00 = ((uint32_t)RxData[0] << 24) |
        ((uint32_t)RxData[1] << 16) |
        ((uint32_t)RxData[2] << 8) |
        (uint32_t)RxData[3];

    // Get the exponent value from RxData
    exponent = RxData[4];

    // Calculate mu and real_num values
    mu = pow(10, exponent);
    real_num = (float)((float)a_00/ mu);

    //    RxData[5] = 0000|0000   4 bit dau la x,y: 0001x 0010y   4 bit sau la ma ket thuc: 0001 gui tiep, 0110 ket thuc
    First_4_bits = (RxData[5] >> 4) & 0x0F; // Lay data and voi 0011|0000 de ra duoc 4 bit dau
    Second_4_bits = RxData[5] & 0x0F; // Lay data and voi 0000|0111 de ra duoc 4 bit sau

    if(Second_4_bits == 0x01 && bit_end == 0) // Ki hieu: tiep tuc gui
	{
    	if(First_4_bits == 0x01) // Neu la X
		{
    		Mang_quy_dao_X[Num_X] = real_num;
    		Mang_quy_dao_X_m[Num_X] = -1*Mang_quy_dao_X[Num_X] / 1000;
			Num_X = Num_X + 1;
		}
		else if(First_4_bits == 0x02) // Neu la Y
		{
			Mang_quy_dao_Y[Num_Y] = real_num;
			Mang_quy_dao_Y_m[Num_Y] = Mang_quy_dao_Y[Num_Y] / 1000;
			Num_Y = Num_Y + 1;
		}
	}
    else if(Second_4_bits == 0x06)
    {
    	if(First_4_bits == 0x01) // Neu la X
		{
    		Mang_quy_dao_X[Num_X] = real_num;
    		Mang_quy_dao_X_m[Num_X] = Mang_quy_dao_X[Num_X] / 1000;
			Num_X = Num_X + 1;
		}
		else if(First_4_bits == 0x02) // Neu la Y
		{
			Mang_quy_dao_Y[Num_Y] = real_num;
			Mang_quy_dao_Y_m[Num_Y] = Mang_quy_dao_Y[Num_Y] / 1000;
			Num_Y = Num_Y + 1;
		}

    	// Gan tat cac gia tri con lai bang 0
    	for(int i = Num_Y + 1; i<Max_Array_XY; i++)
    	{
    		Mang_quy_dao_X[Num_X] = 0;
    		Mang_quy_dao_Y[Num_Y] = 0;
    		Mang_quy_dao_X_m[Num_X] = 0;
    		Mang_quy_dao_Y_m[Num_Y] = 0;
    	}
    	Start_bit_1 = 1;
    	bit_end = 1;
    }
}

// Ngastw I2C Part 2
void HAL_I2C_AddrCallback(I2C_HandleTypeDef*hi2c,uint8_t TransferDirection,uint16_t AddrMatchCode)
{
		if(TransferDirection == I2C_DIRECTION_TRANSMIT)
		{
			HAL_I2C_Slave_Sequential_Receive_IT(hi2c,RxData, RxSIZE,I2C_FIRST_AND_LAST_FRAME);
		}
		else
		{
			Error_Handler();
		}
}




// Ngắt Timer
void HAL_TIM_PeriodElapsedCallback(TIM_HandleTypeDef *htim)
{
	if (htim -> Instance == TIM8)
	{
		HAL_GPIO_TogglePin(GPIOE, GPIO_PIN_15);
		//if(Start_bit_2 == 1 && Time_10 >= 0.5)
		//{
//		// Khai báo đư�?ng đi
//		//Test_duong_thang(pt_pos_1, 0.5, 0.1, pt_Kine->X_real, pt_Kine->Y_real); // Tính ra vị trí x, y và theta cho robot cần bám
//		pt_pos_1->x = (pt_Kine->Y_real - b)/(a);  // Cập nhật vị trí x quy hoạch
//		pt_pos_1->y = a * pt_pos_1->x + b;   // Cập nhật vị trí y quy hoạch
//		pt_pos_1->theta_tiep_tuyen = atan2f((a*(pt_pos_1->x + Delta_S) + b - pt_pos_1->y), Delta_S);  // Góc tiếp tuyến với quỹ đạo mà xe hướng đến
//
//		// Xử lý sai số để ra output PID system ra được sai số lưu vào ek
//		Processing_Error(pt_PID_theta, pt_PID_posision, pt_pos_1, pt_Kine->X_real, pt_Kine->Theta_Real_Robot);
//
//		// Tính Out put PID vị trí và tiếp tuyến ra được 2 hệ số K
//		PID_XY(pt_PID_posision); // PID vị trí
//		PID_XY(pt_PID_theta);  // PID góc tiếp tuyến
//
//		// Tính PID hệ thống ra biến K
//		//Output_K_PID(pt_Kine, pt_Robot, pt_Para_MR, pt_Para_ML, pt_PID_posision, pt_PID_theta);
//		Output_PID_K_0 = (pt_PID_posision->Output + pt_PID_theta->Output)/2.0;
//		pt_Kine->VR_Set =   Output_PID_K_0 * (pt_Robot->L / 2.0)   + pt_Kine->V_Set; // v1 = u1*L/2 + vconst;
//		pt_Kine->VL_Set = -(Output_PID_K_0 * (pt_Robot->L / 2.0))  + pt_Kine->V_Set; // v2 = -u1*L/2 + vconst;
//		pt_Kine->V_Set = (pt_Kine->VR_Set + pt_Kine->VL_Set)/2.0;  // v = (v1+v2)/2;
//		pt_Para_MR->SP_Rad_s = pt_Kine->VR_Set/pt_Robot->R;  //wr = v1/R;
//		pt_Para_ML->SP_Rad_s = pt_Kine->VL_Set/pt_Robot->R;  // wl = v2/R

		// �?�?c encoder động cơ trái và phải
		RPM_Calc(&htim3, pt_Para_MR);
		RPM_Calc(&htim4, pt_Para_ML);

		// PID cho động cơ trái và phải
		PID_control(&htim2, pt_Para_MR, TIM_CHANNEL_1);
		PID_control(&htim1, pt_Para_ML, TIM_CHANNEL_1);

		// �?ảo chi�?u khi e âm
		if(pt_Para_MR->Temp_PWM_1 >= 0)
		{
			Inverse_Right_Motor(0);
			pt_Para_MR->Out_PWM = (uint16_t)pt_Para_MR->Temp_PWM_1;
		}
		else if(pt_Para_MR->Temp_PWM_1 < 0)
		{
			Inverse_Right_Motor(1);
			pt_Para_MR->Out_PWM = (uint16_t)-pt_Para_MR->Temp_PWM_1;
		}
		if(pt_Para_ML->Out_fPWM >= 0)
		{
			Inverse_Left_Motor(0);
			pt_Para_ML->Out_PWM = (uint16_t)pt_Para_ML->Temp_PWM_1;
		}
		else if(pt_Para_ML->Out_fPWM < 0)
		{
			Inverse_Left_Motor(1);
			pt_Para_ML->Out_PWM = (uint16_t)-pt_Para_ML->Temp_PWM_1;
		}


//		/************************Fuzzy*************************/
//		// Xử lí RPM
//		pt_Para_MR->ek = (pt_Para_MR->SP_RPM - pt_Para_MR->RPM);	// Xác định sai số
//
//		// Input1 là sai số thông thư�?ng
//		e1 = pt_Para_MR->ek / 33.5;   // Chia cho 33.5 vì maximum velocity
//		Processing(e1, 5, IN_01, ID1, Value_ID_1);
//		// Input2 là tích luỹ sai số
//		error_integration_fuzzy = error_integration_fuzzy_P + (pt_Para_MR->ek*Time_Interrupt); // Tinhs ra sai số tích luỹ
//		e2 = error_integration_fuzzy/33.5;
//		// Khâu bão hoà của Fuzzy
//		if(error_integration_fuzzy_P>50)
//		{
//			error_integration_fuzzy_P = 50.0;
//		}
//		else if(error_integration_fuzzy_P<-50)
//		{
//			error_integration_fuzzy_P = -50.0;
//		}
//		Processing(e2, 5, IN_02, ID2, Value_ID_2);
//		//Xử lí luật đi�?u khiển
//	     Rule(ID1, ID2, OUT_01, Value_ID_1, Value_ID_2, 0 , Temp_01, 0, 0, 0);  // Rule 1 (0 0 1)
//	     Rule(ID1, ID2, OUT_01, Value_ID_1, Value_ID_2, 1 , Temp_01, 0, 1, 0);  // Rule 2 (0 0 1)
//	     Rule(ID1, ID2, OUT_01, Value_ID_1, Value_ID_2, 2 , Temp_01, 0, 2, 1);  // Rule 3 (0 0 1)
//	     Rule(ID1, ID2, OUT_01, Value_ID_1, Value_ID_2, 3 , Temp_01, 0, 3, 2);  // Rule 4 (0 0 1)
//	     Rule(ID1, ID2, OUT_01, Value_ID_1, Value_ID_2, 4 , Temp_01, 0, 4, 2);  // Rule 5 (0 0 1)
//	     Rule(ID1, ID2, OUT_01, Value_ID_1, Value_ID_2, 5 , Temp_01, 1, 0, 0);  // Rule 6 (0 0 1)
//	     Rule(ID1, ID2, OUT_01, Value_ID_1, Value_ID_2, 6 , Temp_01, 1, 1, 1);  // Rule 7 (0 0 1)
//	     Rule(ID1, ID2, OUT_01, Value_ID_1, Value_ID_2, 7 , Temp_01, 1, 2, 1);  // Rule 8 (0 0 1)
//	     Rule(ID1, ID2, OUT_01, Value_ID_1, Value_ID_2, 8 , Temp_01, 1, 3, 2);  // Rule 9 (0 0 1)
//	     Rule(ID1, ID2, OUT_01, Value_ID_1, Value_ID_2, 9 , Temp_01, 1, 4, 2);  // Rule 10 (0 0 1)
//	     Rule(ID1, ID2, OUT_01, Value_ID_1, Value_ID_2, 10, Temp_01, 2, 0, 1);  // Rule 11 (0 0 1)
//	     Rule(ID1, ID2, OUT_01, Value_ID_1, Value_ID_2, 11, Temp_01, 2, 1, 1);  // Rule 12 (0 0 1)
//	     Rule(ID1, ID2, OUT_01, Value_ID_1, Value_ID_2, 12, Temp_01, 2, 2, 2);  // Rule 13 (0 0 1)
//	     Rule(ID1, ID2, OUT_01, Value_ID_1, Value_ID_2, 13, Temp_01, 2, 3, 3);  // Rule 14 (0 0 1)
//	     Rule(ID1, ID2, OUT_01, Value_ID_1, Value_ID_2, 14, Temp_01, 2, 4, 4);  // Rule 15 (0 0 1)
//	     Rule(ID1, ID2, OUT_01, Value_ID_1, Value_ID_2, 15, Temp_01, 3, 0, 2);  // Rule 16 (0 0 1)
//	     Rule(ID1, ID2, OUT_01, Value_ID_1, Value_ID_2, 16, Temp_01, 3, 1, 2);  // Rule 17 (0 0 1)
//	     Rule(ID1, ID2, OUT_01, Value_ID_1, Value_ID_2, 17, Temp_01, 3, 2, 3);  // Rule 18 (0 0 1)
//	     Rule(ID1, ID2, OUT_01, Value_ID_1, Value_ID_2, 18, Temp_01, 3, 3, 4);  // Rule 19 (0 0 1)
//	     Rule(ID1, ID2, OUT_01, Value_ID_1, Value_ID_2, 19, Temp_01, 3, 4, 4);  // Rule 20 (0 0 1)
//	     Rule(ID1, ID2, OUT_01, Value_ID_1, Value_ID_2, 20, Temp_01, 4, 0, 2);  // Rule 21 (0 0 1)
//	     Rule(ID1, ID2, OUT_01, Value_ID_1, Value_ID_2, 21, Temp_01, 4, 1, 2);  // Rule 22 (0 0 1)
//	     Rule(ID1, ID2, OUT_01, Value_ID_1, Value_ID_2, 22, Temp_01, 4, 2, 4);  // Rule 23 (0 0 1)
//	     Rule(ID1, ID2, OUT_01, Value_ID_1, Value_ID_2, 23, Temp_01, 4, 3, 4);  // Rule 24 (0 0 1)
//	     Rule(ID1, ID2, OUT_01, Value_ID_1, Value_ID_2, 24, Temp_01, 4, 4, 4);  // Rule 25 (0 0 1)
//	     // Lưu kết quả vào biến Temp_01
//	     //Final_Value_FC(Output_PWM_Fuzzy_Temp, Temp_02, 25, Temp_01);
//	     // Sau khi tạo luật xong thì cộng dồn giá trị vào Final_Value
//
//	     //resset temp
//	     Temp_02[1] = 0;
//	     Temp_02[0] = 0;
//
//	     for(int i=0;i<25;i++)
//	     {
//	    	 Temp_02[0] = Temp_02[0] + Temp_01[i][0];
//	    	 Temp_02[1] = Temp_02[1] + Temp_01[i][1];
//	     }
//
//	     // Kết quả cuối cùng là chia tử với mẫu
//	     Output_PWM_Fuzzy_Temp = Temp_02[0] / Temp_02[1];
//	     Output_PWM_Fuzzy = Output_PWM_Fuzzy_Temp * 1000; // Nhân với độ gain là 1000 vì phân giải PWM là 1000
//
//	     // Xuất xung PWM PID vs Fuzzy
//	     __HAL_TIM_SET_COMPARE(&htim2, TIM_CHANNEL_1, pt_Para_MR->Out_PWM*0.95 + Output_PWM_Fuzzy*0.05);


	     // Xuất xung PWM PID
	     __HAL_TIM_SET_COMPARE(&htim2, TIM_CHANNEL_1, pt_Para_MR->Out_PWM);
	     __HAL_TIM_SET_COMPARE(&htim1, TIM_CHANNEL_1, pt_Para_ML->Out_PWM);

	     // �?ộng h�?c thuận
	     //Forward_Kinematic(pt_Kine, pt_Robot, pt_Para_MR, pt_Para_ML);
	 	pt_Kine->V_real = (pt_Para_MR->Rad_s + pt_Para_ML->Rad_s)*(pt_Robot->R/2); // Tính vận tốc thực tế cho xe
	 	pt_Kine->W_Real = ((pt_Para_MR->Rad_s - pt_Para_ML->Rad_s)*pt_Robot->R)/(2*pt_Robot->L); // Tốc độ quay của robot hiện tại
	 	pt_Kine->X_dot = pt_Kine->V_real*cos(pt_Kine->Theta_Real_Robot); // x dot
	 	pt_Kine->Y_dot = pt_Kine->V_real*sin(pt_Kine->Theta_Real_Robot); // y dot
	 	// Tích phân để ra x,y hiện tại của robot
	 	pt_Kine->X_real = pt_Kine->X_real + pt_Kine->X_dot*Time_Interrupt; // Vị trí của robot phương X
	 	pt_Kine->Y_real = pt_Kine->Y_real + pt_Kine->Y_dot*Time_Interrupt; // Vị trí của robot phương Y

	 	// Chuyen sang mm
	 	pt_Kine->X_real_mm = pt_Kine->X_real * 1000;
	 	pt_Kine->Y_real_mm = pt_Kine->Y_real * 1000;

	 	// Welding
//	 	if(-PI/2 <= theta_robot <= PI/2)
//	 	    Xw = x_robot + d*cos(theta_robot) - (L+Delta_L)*sin(theta_robot);
//	 	    Yw = y_robot + (L+Delta_L)*cos(theta_robot) + d*sin(theta_robot);
//	 	else
//	 	    Xw = x_robot - d*cos(theta_robot - PI/2) - (L+Delta_L)*sin(theta_robot - PI/2);
//	 	    Yw = y_robot + (L+Delta_L)*cos(theta_robot - PI/2) + d*sin(theta_robot - PI/2);
//	 	end

	 	pt_Kine->Theta_Real_Robot = pt_Kine->Theta_Real_Robot + pt_Kine->W_Real * Time_Interrupt; // Cập nhật theta

	 	float Delta_L = 0;

//	 	if(pt_Kine->Theta_Real_Robot <= PI/2 && pt_Kine->Theta_Real_Robot >= -PI/2)
//	 	{
//	 		pt_Kine->X_Welding = pt_Kine->X_real + pt_Robot->Distance_X_tourch*cos(pt_Kine->Theta_Real_Robot) - (pt_Robot->Distance_Y_tourch+Delta_L)*sin(pt_Kine->Theta_Real_Robot);
//	 		pt_Kine->Y_Welding = pt_Kine->Y_real + (pt_Robot->Distance_Y_tourch+Delta_L)*cos(pt_Kine->Theta_Real_Robot) + pt_Robot->Distance_X_tourch*sin(pt_Kine->Theta_Real_Robot);
//	 	}
//	 	else
//		{
//			pt_Kine->X_Welding = pt_Kine->X_real - pt_Robot->Distance_X_tourch*cos(pt_Kine->Theta_Real_Robot - PI/2) - (pt_Robot->Distance_Y_tourch+Delta_L)*sin(pt_Kine->Theta_Real_Robot - PI/2);
//			pt_Kine->Y_Welding = pt_Kine->Y_real + (pt_Robot->Distance_Y_tourch+Delta_L)*cos(pt_Kine->Theta_Real_Robot - PI/2) + pt_Robot->Distance_X_tourch*sin(pt_Kine->Theta_Real_Robot - PI/2);
//		}
//	 	pt_Kine->X_Welding = pt_Kine->X_real + pt_Robot->Distance_X_tourch*cos(pt_Kine->Theta_Real_Robot) - (pt_Robot->Distance_Y_tourch+Delta_L)*sin(pt_Kine->Theta_Real_Robot);
//	 	pt_Kine->Y_Welding = pt_Kine->Y_real + (pt_Robot->Distance_Y_tourch+Delta_L)*cos(pt_Kine->Theta_Real_Robot) + pt_Robot->Distance_X_tourch*sin(pt_Kine->Theta_Real_Robot);

//	 	pt_Kine->X_Welding = pt_Kine->X_real + pt_Robot->Distance_X_tourch*cos(pt_Kine->Theta_Real_Robot) - (pt_Robot->Distance_Y_tourch+Stepper_L )*sin(pt_Kine->Theta_Real_Robot);
//	 	pt_Kine->Y_Welding = pt_Kine->Y_real + (pt_Robot->Distance_Y_tourch+Stepper_L)*cos(pt_Kine->Theta_Real_Robot) + pt_Robot->Distance_X_tourch*sin(pt_Kine->Theta_Real_Robot);

	 	pt_Kine->X_Welding = pt_Kine->X_real;
	 	pt_Kine->Y_Welding = pt_Kine->Y_real;

	     // Gán lại sai số
		error_integration_fuzzy_P = error_integration_fuzzy ;  // Gán sai số tích luỹ

		//UART_1(pt_Kine->X_real, pt_Kine->Y_real);
		//}


	}

	else if (htim->Instance == TIM6)
	{
		if(Start_bit_2 == 1)
		{
			// Khai báo đư�?ng đi
			//Test_duong_thang(pt_pos_1, 0.5, 0.1, pt_Kine->X_real, pt_Kine->Y_real); // Tính ra vị trí x, y và theta cho robot cần bám
	//		pt_pos_1->x = (pt_Kine->Y_real - b)/(a_0);  // Cập nhật vị trí x quy hoạch
	//		pt_pos_1->y = a_0 * pt_pos_1->x + b;   // Cập nhật vị trí y quy hoạch
	//		pt_pos_1->theta_tiep_tuyen = atan2f((a_0*(pt_pos_1->x + Delta_S) + b - pt_pos_1->y), Delta_S);  // Góc tiếp tuyến với quỹ đạo mà xe hướng đến
			// Test moi
	//		pt_pos_1->x = FC_1(pt_Kine->Y_real);
	//		pt_pos_1->y = pt_Kine->Y_real;
			//New method
			Path_planing(Mang_quy_dao_X_m, Mang_quy_dao_Y_m, Mang_Robot_1, pt_pos_1, pt_Kine, Vi_tri_1);
			//pt_pos_1->theta_tiep_tuyen = ((5.52*10^(-8)* (pt_pos_1->y+Delta_S)^4 - 5.456*10^(-5)*(pt_pos_1->y+Delta_S)^3 + 0.01686*(pt_pos_1->y+Delta_S)^2- 1.783*(pt_pos_1->y+Delta_S) + 309.7) - 5.52*10^(-8)* pt_pos_1->y^4 - 5.456*10^(-5)*pt_pos_1->y^3 + 0.01686*pt_pos_1->y^2- 1.783*pt_pos_1->y + 309.7)/Delta_S;
			pt_pos_1->theta_tiep_tuyen = atan2(Mang_Robot_1[1][1] - Mang_Robot_1[0][1],Mang_Robot_1[1][0]-Mang_Robot_1[0][0]);

			// Xử lý sai số để ra output PID system ra được sai số lưu vào ek
			Processing_Error(pt_PID_theta, pt_PID_posision, pt_pos_1, pt_Kine->X_Welding, pt_Kine->Theta_Real_Robot);
			ek_mm = pt_PID_posision->ek * 1000;
			ek_degree = pt_PID_theta->ek * 180/PI;

			float em = pt_PID_posision->ek*1000;

			//Time_10 = Time_10 + 0.2;

			if(em >= 20)
			{
				em = 20;
			}
			else if(em <= -20)
			{
				em = -20;
			}
			//Stepper_L = ((float)Counter_AC/200)*0.004;

			 //Stepper(em);


			// Tính Out put PID vị trí và tiếp tuyến ra được 2 hệ số K
			PID_XY(pt_PID_posision); // PID vị trí
			PID_XY(pt_PID_theta);  // PID góc tiếp tuyến

			// Tính PID hệ thống ra biến K
			//Output_K_PID(pt_Kine, pt_Robot, pt_Para_MR, pt_Para_ML, pt_PID_posision, pt_PID_theta);
			Output_PID_K_0 = (pt_PID_posision->Output + pt_PID_theta->Output)/2.0;
			pt_Kine->VR_Set =   Output_PID_K_0 * (pt_Robot->L / 2.0)   + pt_Kine->V_Set; // v1 = u1*L/2 + vconst;
			pt_Kine->VL_Set = -(Output_PID_K_0 * (pt_Robot->L / 2.0))  + pt_Kine->V_Set; // v2 = -u1*L/2 + vconst;
			pt_Kine->V_Set_1 = (pt_Kine->VR_Set + pt_Kine->VL_Set)/2.0;  // v = (v1+v2)/2;
			pt_Para_MR->SP_Rad_s = pt_Kine->VR_Set/pt_Robot->R;  //wr = v1/R;
			pt_Para_ML->SP_Rad_s = pt_Kine->VL_Set/pt_Robot->R;  // wl = v2/R
			}

	}
	else if (htim->Instance == TIM10)
	{
//		float em = pt_PID_posision->ek*1000;
//
//		Time_10 = Time_10 + 0.2;
//
////		Stepper_L = Stepper_L + em*Time_10;
//		if(em >= 20)
//		{
//			em = 20;
//		}
//		else if(em <= -20)
//		{
//			em = -20;
//		}
//		Stepper_L = ((float)Counter_AC/200)*0.004;
//
//		 Stepper(em);


	}
	else if (htim->Instance == TIM11)
	{
		//Time_10 = Time_10 + 0.01;
		if(Start_bit_1 == 1)
		  {
			  Time_10 = Time_10 + 0.01;
		  }
		if(Start_bit_1 == 1 && Time_10 < 0.1)
		{
			  // New method
			  pt_Kine->X_Welding = Mang_quy_dao_X_m[0];
			  pt_Kine->Y_Welding = Mang_quy_dao_Y_m[0];
			  pt_Kine->X_real = pt_Kine->X_Welding;
			  pt_Kine->Y_real = pt_Kine->Y_Welding;
			  float Delta_L = 0;
//			  pt_Kine->X_real = -pt_Kine->X_Welding + pt_Robot->Distance_X_tourch*cos(pt_Kine->Theta_Real_Robot) - (pt_Robot->Distance_Y_tourch+Delta_L)*sin(pt_Kine->Theta_Real_Robot);
//			  pt_Kine->Y_real = -pt_Kine->Y_Welding + (pt_Robot->Distance_Y_tourch+Delta_L)*cos(pt_Kine->Theta_Real_Robot) + pt_Robot->Distance_X_tourch*sin(pt_Kine->Theta_Real_Robot);
			  for(int i=0; i<2; i++)
			  {
				  Mang_Robot_1[i][0] = Mang_quy_dao_X_m[Vi_tri_1 + i];
				  Mang_Robot_1[i][1] = Mang_quy_dao_Y_m[Vi_tri_1 + i];
			  }
			  Start_bit_2 = 1;
		  }
	}
}
/* USER CODE END 4 */

/**
  * @brief  This function is executed in case of error occurrence.
  * @retval None
  */
void Error_Handler(void)
{
  /* USER CODE BEGIN Error_Handler_Debug */
  /* User can add his own implementation to report the HAL error return state */
  __disable_irq();
  while (1)
  {
  }
  /* USER CODE END Error_Handler_Debug */
}

#ifdef  USE_FULL_ASSERT
/**
  * @brief  Reports the name of the source file and the source line number
  *         where the assert_param error has occurred.
  * @param  file: pointer to the source file name
  * @param  line: assert_param error line source number
  * @retval None
  */
void assert_failed(uint8_t *file, uint32_t line)
{
  /* USER CODE BEGIN 6 */
  /* User can add his own implementation to report the file name and line number,
     ex: printf("Wrong parameters value: file %s on line %d\r\n", file, line) */
  /* USER CODE END 6 */
}
#endif /* USE_FULL_ASSERT */
